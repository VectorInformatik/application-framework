AUTOSAR XML (schema 00049)
package /deployment/Provided
  provided user defined service instance Provided_BrakeServiceInterfaceDeployment_service_instance: service-interface-deployment=BrakeServiceInterfaceDeployment
package /deployment/Provided/Mapping
  service instance to port prototype mapping Provided_BrakeServiceInterfaceDeployment_service_instance_toPort: port-prototype=rootSwc.PPort_BrakeService, process=adas_application_process, service-instance=Provided_BrakeServiceInterfaceDeployment_service_instance
package /deployment/Required
  4 x required user defined service instance:
    Required_VelocityServiceInterfaceDeployment_service_instance: service-interface-deployment=VelocityServiceInterfaceDeployment
    Required_SteeringAngleServiceInterfaceDeployment_service_instance: service-interface-deployment=SteeringAngleServiceInterfaceDeployment
    Required_ImageServiceInterfaceDeployment_service_instance1: service-interface-deployment=ImageServiceInterfaceDeployment
    Required_ImageServiceInterfaceDeployment_service_instance2: service-interface-deployment=ImageServiceInterfaceDeployment
package /deployment/Required/Mapping
  4 x service instance to port prototype mapping, all with process=adas_application_process:
    Required_VelocityServiceInterfaceDeployment_service_instance_toPort: port-prototype=rootSwc.RPort_VelocityService, service-instance=Required_VelocityServiceInterfaceDeployment_service_instance
    Required_ImageServiceInterfaceDeployment_service_instance1_toPort: port-prototype=rootSwc.RPort_ImageService1, service-instance=Required_ImageServiceInterfaceDeployment_service_instance1
    Required_ImageServiceInterfaceDeployment_service_instance2_toPort: port-prototype=rootSwc.RPort_ImageService2, service-instance=Required_ImageServiceInterfaceDeployment_service_instance2
    Required_SteeringAngleServiceInterfaceDeployment_service_instance_toPort: port-prototype=rootSwc.RPort_SteeringAngleService, service-instance=Required_SteeringAngleServiceInterfaceDeployment_service_instance
