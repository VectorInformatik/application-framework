AUTOSAR XML (schema 00049)
package /vector/Machine/mappings
  process to machine mapping set adas_demo_Process_MachineMappingSet
    process to machine mapping adas_demo_Process_MachineMapping: machine=AdasDemoMachine, process=adas_application_process
  dlt log channel to process mapping adas_demo_LogChannelToProcessMapping: dlt-log-channel=AdasDemoLogChannel, process=adas_application_process
package /vector/AdasDemo/cm/ServiceInterfaces
  4 x service interface:
    ImageService
      namespaces:
        symbol props ns0: symbol=AF
        symbol props ns1: symbol=adas_demo_app
        symbol props ns2: symbol=services
      events:
        data camera_image: type=Image
      field image_scaling_factor: type=uint64_t, has-getter=true, has-notifier=true, has-setter=true
      methods:
        operation GetImageSize
          arg width: type=uint16_t, direction=OUT
          arg height: type=uint16_t, direction=OUT
    BrakeService
      namespaces:
        symbol props ns0: symbol=AF
        symbol props ns1: symbol=adas_demo_app
        symbol props ns2: symbol=services
      events:
        data brake_action: type=BrakePressure
      field brake_summand_coefficient: type=uint64_t, has-getter=true, has-notifier=true, has-setter=true
      methods:
        operation SumTwoSummands
          arg summand_one: type=uint16_t, direction=IN
          arg summand_two: type=uint16_t, direction=IN
          arg sum: type=uint16_t, direction=OUT
    VelocityService
      namespaces:
        symbol props ns0: symbol=AF
        symbol props ns1: symbol=adas_demo_app
        symbol props ns2: symbol=services
      events:
        data car_velocity: type=Velocity
      methods:
        operation SetVelocity: fire-and-forget=true
          arg velocity: type=uint32_t, direction=IN
    SteeringAngleService
      namespaces:
        symbol props ns0: symbol=AF
        symbol props ns1: symbol=adas_demo_app
        symbol props ns2: symbol=services
      events:
        data steering_angle: type=SteeringAngle
package /vector/AdasDemo/cm/DataTypes
  7 x std cpp implementation data type, all with type-emitter=TYPE_EMITTER_ARA:
    Velocity: category=STRUCTURE
      namespaces:
        symbol props ns1: symbol=datatypes
      cpp implementation data type element timestamp: type-reference=uint64_t
      cpp implementation data type element velocity: type-reference=uint16_t
    SteeringAngle: category=STRUCTURE
      namespaces:
        symbol props ns1: symbol=datatypes
      cpp implementation data type element timestamp: type-reference=uint64_t
      cpp implementation data type element steering_angle: type-reference=AngleType
    Image: category=STRUCTURE
      namespaces:
        symbol props ns1: symbol=datatypes
      6 x cpp implementation data type element:
        timestamp: type-reference=uint64_t
        height: type-reference=uint16_t
        width: type-reference=uint16_t
        R: type-reference=UInt8Vector
        G: type-reference=UInt8Vector
        B: type-reference=UInt8Vector
    UInt8Vector: category=VECTOR, array-size=307200, cpp-template-argument=uint8_t
      namespaces:
        symbol props ns1: symbol=datatypes
    BrakePressure: category=ASSOCIATIVE_MAP
      namespaces:
        symbol props ns0: symbol=datatypes
      template-arguments:
        category=ASSOC_MAP_KEY, template-type=uint64_t
        category=ASSOC_MAP_VALUE, template-type=PressureType
    PressureType: type-reference=uint8_t
      namespaces:
        symbol props ns0: symbol=datatypes
    AngleType: type-reference=uint16_t
      namespaces:
        symbol props ns0: symbol=datatypes
package /deployment
  user defined service interface deployment ImageServiceInterfaceDeployment: service-interface=ImageService
    user defined event deployment camera_image: event=camera_image
    user defined field deployment testFieldUINT8Deployment: field=image_scaling_factor
      get getter
      notifier Notifier
      set setter
    user defined method deployment GetImageSize: method=GetImageSize
