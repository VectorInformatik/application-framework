AUTOSAR XML (schema 00049)
package /deployment
  user defined service interface deployment BrakeServiceInterfaceDeployment: service-interface=BrakeService
    user defined event deployment brake_action: event=brake_action
    user defined field deployment testFieldUINT8Deployment: field=brake_summand_coefficient
      get getter
      notifier Notifier
      set setter
    user defined method deployment SumTwoSummands: method=SumTwoSummands
  user defined service interface deployment VelocityServiceInterfaceDeployment: service-interface=VelocityService
    user defined event deployment car_velocity: event=car_velocity
    user defined method deployment SetVelocity: method=SetVelocity
  user defined service interface deployment SteeringAngleServiceInterfaceDeployment: service-interface=SteeringAngleService
    user defined event deployment steering_angle: event=steering_angle
