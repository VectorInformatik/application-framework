AUTOSAR XML (schema 00049)
package /vector/Machine
  machine design AdasDemoMachineDesign: service-discover-configs=someip-service-discovery={multicast-sd-ip-address=SdMulticastEndpoint, someip-service-discovery-port=12330}
    ethernet communication connector EthernetConnector: unicast-network-endpoint=NetworkEndpoint
  mode declaration group MachineStates: initial-mode=Off
    6 x mode:
      Verify: value=5
      Running: value=0
      Startup: value=1
      Shutdown: value=2
      Restart: value=3
      Off: value=4
  ethernet cluster AdasDemoEthernetCluster
    ethernet physical channel EthCh1
      network endpoint NetworkEndpoint: network-endpoint-addresses=ipv-4-configuration={ipv-4-address=192.168.7.2, ipv-4-address-source=FIXED, ttl=5}
      network endpoint SdMulticastEndpoint: network-endpoint-addresses=ipv-4-configuration=ipv-4-address=224.0.0.17
  function group set AdasDemoMachine_FunctionGroupSet
    function-groups:
      mode declaration group prototype MachineFG: type=MachineStates
  machine AdasDemoMachine: machine-design=AdasDemoMachineDesign
    module-instantiations:
      log and trace instantiation AdasDemoLogAndTrace
        dlt log channel AdasDemoLogChannel: application-description=Adas demo test app, application-id=vTSA, context-description=Adas demo test app, context-id=default, log-trace-default-log-level=INFO, log-trace-file-path=tmp, log-trace-log-modes=CONSOLE
    processor Processor
      4 x processor core:
        Core{0..3}: core-id={0..3}
