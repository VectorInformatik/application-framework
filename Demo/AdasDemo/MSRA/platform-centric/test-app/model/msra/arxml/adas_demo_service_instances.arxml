AUTOSAR XML (schema 00049)
package /deployment/Provided
  4 x provided user defined service instance:
    Provided_VelocityServiceInterfaceDeployment_service_instance: service-interface-deployment=VelocityServiceInterfaceDeployment
    Provided_SteeringAngleServiceInterfaceDeployment_service_instance: service-interface-deployment=SteeringAngleServiceInterfaceDeployment
    Provided_ImageServiceInterfaceDeployment_service_instance1: service-interface-deployment=ImageServiceInterfaceDeployment
    Provided_ImageServiceInterfaceDeployment_service_instance2: service-interface-deployment=ImageServiceInterfaceDeployment
package /deployment/Provided/Mapping
  4 x service instance to port prototype mapping, all with process=adas_platform_process:
    Provided_VelocityServiceInterfaceDeployment_service_instance_toPort: port-prototype=RootSwComponentPrototype.PPort_VelocityService, service-instance=Provided_VelocityServiceInterfaceDeployment_service_instance
    Provided_SteeringAngleServiceInterfaceDeployment_service_instance_toPort: port-prototype=RootSwComponentPrototype.PPort_SteeringAngleService, service-instance=Provided_SteeringAngleServiceInterfaceDeployment_service_instance
    Provided_ImageServiceInterfaceDeployment_service_instance1_toPort: port-prototype=RootSwComponentPrototype.PPort_ImageService1, service-instance=Provided_ImageServiceInterfaceDeployment_service_instance1
    Provided_ImageServiceInterfaceDeployment_service_instance2_toPort: port-prototype=RootSwComponentPrototype.PPort_ImageService2, service-instance=Provided_ImageServiceInterfaceDeployment_service_instance2
package /deployment/Required
  required user defined service instance Required_BrakeServiceInterfaceDeployment_service_instance: service-interface-deployment=BrakeServiceInterfaceDeployment
package /deployment/Required/Mapping
  service instance to port prototype mapping Required_BrakeServiceInterfaceDeployment_service_instance_toPort: port-prototype=RootSwComponentPrototype.RPort_BrakeService, process=adas_platform_process, service-instance=Required_BrakeServiceInterfaceDeployment_service_instance
