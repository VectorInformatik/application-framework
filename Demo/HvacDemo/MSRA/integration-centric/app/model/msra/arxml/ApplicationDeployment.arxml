AUTOSAR XML (schema 00049)
package /AppDeployment
  ethernet cluster EthCluster_AppLocalNetwork
    ethernet physical channel EthernetChannel_AppLocalNetwork
      network endpoint TcpEndpoint_AppLocalNetwork: network-endpoint-addresses=ipv-4-configuration={ipv-4-address=127.0.0.1, ipv-4-address-source=FIXED, network-mask=255.255.255.0, ttl=5}
      network endpoint UdpEndpoint_AppLocalNetwork: network-endpoint-addresses=ipv-4-configuration=ipv-4-address=224.0.0.17
      vlan Vlan_AppLocalNetwork: vlan-identifier=12
  5 x mode declaration group:
    Default_ProcessStates: initial-mode=Default_ProcessStates/Running
      mode Running: value=0
      mode Terminating: value=1
    Default_MachineStates: initial-mode=Default_MachineStates/Off
      10 x mode:
        Off: value=0
        Startup: value=1
        Running: value=2
        Shutdown: value=3
        Restart: value=4
        Suspended: value=5
        Failsafe: value=6
        RunningSafe: value=7
        RunningLowPower: value=8
        Verify: value=9
    Default_PlatformApplicationStates: initial-mode=Default_PlatformApplicationStates/Off
      10 x mode:
        Off: value=0
        Startup: value=1
        Running: value=2
        Shutdown: value=3
        Restart: value=4
        Suspended: value=5
        Failsafe: value=6
        RunningSafe: value=7
        RunningLowPower: value=8
        Verify: value=9
    Default_ApplicationStates: initial-mode=Default_ApplicationStates/Off
      10 x mode:
        Off: value=0
        Startup: value=1
        Running: value=2
        Shutdown: value=3
        Restart: value=4
        Suspended: value=5
        Failsafe: value=6
        RunningSafe: value=7
        RunningLowPower: value=8
        Verify: value=9
    Default_TestStubStates: initial-mode=Default_TestStubStates/Off
      10 x mode:
        Off: value=0
        Startup: value=1
        Running: value=2
        Shutdown: value=3
        Restart: value=4
        Suspended: value=5
        Failsafe: value=6
        RunningSafe: value=7
        RunningLowPower: value=8
        Verify: value=9
  function group set FuncGrpSet_AppLocalMachine
    function-groups:
      4 x mode declaration group prototype:
        MachineFG: type=Default_MachineStates
        PlatformApplicationFG: type=Default_PlatformApplicationStates
        ApplicationFG: type=Default_ApplicationStates
        DevTestStubFG: type=Default_TestStubStates
  machine design MachineDesign_AppLocalMachine: service-discover-configs=someip-service-discovery={multicast-sd-ip-address=UdpEndpoint_AppLocalNetwork, someip-service-discovery-port=12330}
    ethernet communication connector EthComConnectorName_AppLocalMachine: unicast-network-endpoint=TcpEndpoint_AppLocalNetwork
    user defined communication connector UserDefCommConnector_Ipc_AppLocalMachine
  machine AppLocalMachine: default-application-timeout={enter-timeout-value=2.33, exit-timeout-value=4.56}, machine-design=MachineDesign_AppLocalMachine
    module-instantiations:
      log and trace instantiation LogAndTraceModule_AppLocalMachine: dlt-ecu-id=ECUT
        dlt log channel LogChannel_Prc_App_ModelBuilderApplication_HvacApplication: application-id=AP00, context-id=default, log-trace-default-log-level=INFO, log-trace-log-modes=CONSOLE
      os module instantiation OsModule_AppLocalMachine
        resource group AppResourcGrp_AppLocalMachine_Small: cpu-usage=25, mem-usage=10000000
        resource group AppResourcGrp_AppLocalMachine_Medium: cpu-usage=50, mem-usage=50000000
        resource group AppResourcGrp_AppLocalMachine_Large: cpu-usage=75, mem-usage=100000000
      crypto module instantiation CryptoModule_AppLocalMachine
    processor ProcOne
      4 x processor core:
        Core{0..3}: core-id={0..3}
  someip sd client service instance config DefaultSomeipSdClientServiceInstanceConfig: initial-find-behavior={initial-delay-max-value=0.1, initial-delay-min-value=0.01, initial-repetitions-base-delay=0.2, initial-repetitions-max=5}, service-find-time-to-live=5
  someip sd client event group timing config DefaultSomeipSdClientEventGroupTimingConfig: request-response-delay={max-value=1.5, min-value=1.5}, subscribe-eventgroup-retry-delay=5.5, subscribe-eventgroup-retry-max=3, time-to-live=5
  someip sd server service instance config DefaultSomeipSdServerServiceInstanceConfig: initial-offer-behavior={initial-delay-max-value=0.1, initial-delay-min-value=0.01, initial-repetitions-base-delay=0.2, initial-repetitions-max=5}, offer-cyclic-delay=5, request-response-delay={max-value=1.5, min-value=1.5}, service-offer-time-to-live=10
  someip sd server event group timing config DefaultSomeipSdServerEventGroupTimingConfig: request-response-delay={max-value=1.5, min-value=1.5}
  startup config set SCfgSet_App_ModelBuilderApplication_HvacApplication
    startup config StartupForStateStartup: process-arguments=[-c, ./etc/application.json], scheduling-policy=SCHED_RR, scheduling-priority=32, termination-behavior=PROCESS-IS-NOT-SELF-TERMINATING, timeout={enter-timeout-value=30, exit-timeout-value=30}
    startup config StartupForStateRunning: process-arguments=[-c, ./etc/application.json], scheduling-policy=SCHED_RR, scheduling-priority=32, termination-behavior=PROCESS-IS-NOT-SELF-TERMINATING, timeout={enter-timeout-value=30, exit-timeout-value=30}
  process Prc_App_ModelBuilderApplication_HvacApplication: design=PrcDesign_App_ModelBuilderApplication_HvacApplication, executable=HvacApplication
    process state machine ProcessStates: type=Default_ProcessStates
    state-dependent-startup-configs:
      function-group-state=MachineFG.Startup, resource-group=AppResourcGrp_AppLocalMachine_Medium, startup-config=StartupForStateStartup
      function-group-state=MachineFG.Running, resource-group=AppResourcGrp_AppLocalMachine_Medium, startup-config=StartupForStateRunning
  dlt log channel to process mapping LogCh2PrcMap_Prc_App_ModelBuilderApplication_HvacApplication_ctxDefault: dlt-log-channel=LogChannel_Prc_App_ModelBuilderApplication_HvacApplication, process=Prc_App_ModelBuilderApplication_HvacApplication
  software cluster SwCl_App_ModelBuilderApplication: category=PLATFORM_CORE, claimed-function-group=MachineFG, contained-process=Prc_App_ModelBuilderApplication_HvacApplication, design=SwClDesign_App_ModelBuilderApplication, software-cluster-doip-diagnostic-address{address-semantics=PHYSICAL-ADDRESS, diagnostic-address=1}, vendor-id=34, version=1.0.0
  process to machine mapping set Prc2MachMapSet_AppLocalMachine
    process to machine mapping Mach2ProcMap_AppLocalMachine_Prc_App_ModelBuilderApplication_HvacApplication: machine=AppLocalMachine, process=Prc_App_ModelBuilderApplication_HvacApplication
  someip sd client service instance config SomeipSdClientSvcInstCfg_HvacApplication: initial-find-behavior={initial-delay-max-value=0.1, initial-delay-min-value=0.01, initial-repetitions-base-delay=0.2, initial-repetitions-max=5}, service-find-time-to-live=5
  someip sd client event group timing config SomeipSdClientEvGrpTimingCfg_HvacApplication: request-response-delay={max-value=1.5, min-value=1.5}, subscribe-eventgroup-retry-delay=5.5, subscribe-eventgroup-retry-max=3, time-to-live=10
  someip sd server service instance config SomeipSdServerSvcInstCfg__HvacApplication: initial-offer-behavior={initial-delay-max-value=0.1, initial-delay-min-value=0.01, initial-repetitions-base-delay=0.2, initial-repetitions-max=5}, offer-cyclic-delay=5, request-response-delay={max-value=1.5, min-value=1.5}, service-offer-time-to-live=10
  someip sd server event group timing config SomeipSdServerEvGrpTimingCfg_HvacApplication: request-response-delay={max-value=1.5, min-value=1.5}
  provided user defined service instance PrvIpcSvcInst_HvacApplication_From_PPort_HvacControl: service-interface-deployment=IpcSvcIfDeploy_HvacControl
  service instance to port prototype mapping PrvIpcSvcInst2PortPMap_PrvIpcSvcInst_HvacApplication_From_PPort_HvacControl: enables-log-trace=true, port-prototype=RootSwcPrototype.HvacControl, process=Prc_App_ModelBuilderApplication_HvacApplication, service-instance=PrvIpcSvcInst_HvacApplication_From_PPort_HvacControl
  user defined service instance to machine mapping PrvIpcSvcInst2MM_PrvIpcSvcInst_HvacApplication_From_PPort_HvacControl: communication-connector=UserDefCommConnector_Ipc_AppLocalMachine, service-instance=PrvIpcSvcInst_HvacApplication_From_PPort_HvacControl
  required user defined service instance ReqIpcSvcInst_HvacApplication_From_RPort_HvacStatus: service-interface-deployment=IpcSvcIfDeploy_HvacStatus
  service instance to port prototype mapping ReqIpcSvcInst2PortPMap_ReqIpcSvcInst_HvacApplication_From_RPort_HvacStatus: enables-log-trace=true, port-prototype=RootSwcPrototype.HvacStatus, process=Prc_App_ModelBuilderApplication_HvacApplication, service-instance=ReqIpcSvcInst_HvacApplication_From_RPort_HvacStatus
  user defined service instance to machine mapping ReqIpcSvcInst2MM_ReqIpcSvcInst_HvacApplication_From_RPort_HvacStatus: communication-connector=UserDefCommConnector_Ipc_AppLocalMachine, service-instance=ReqIpcSvcInst_HvacApplication_From_RPort_HvacStatus
