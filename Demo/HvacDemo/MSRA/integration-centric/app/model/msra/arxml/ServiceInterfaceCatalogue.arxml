AUTOSAR XML (schema 00049)
package /ServiceInterfaces/PkgHvacControl/Latest
  service interface HvacControl
    namespaces:
      symbol props ns0: symbol=nsprototype
      symbol props ns1: symbol=nsserviceinterface
      symbol props ns2: symbol=nshvaccontrol
    events:
      data CompressorState: type=uint8_t
      data ValvePosition: type=uint8_t
      data FanSpeed: type=uint8_t
    methods:
      operation ChangeTemperature: fire-and-forget=false
        arg Value: type=uint8_t, direction=IN
package /ServiceInterfaces/PkgHvacControl/Latest/PkgDeployment
  user defined service interface deployment IpcSvcIfDeploy_HvacControl: service-interface=HvacControl
    user defined event deployment IpcEventDeploy_CompressorState: event=CompressorState
    user defined event deployment IpcEventDeploy_ValvePosition: event=ValvePosition
    user defined event deployment IpcEventDeploy_FanSpeed: event=FanSpeed
    user defined method deployment IpcMethodDeploy_ChangeTemperature: method=ChangeTemperature
package /ServiceInterfaces/PkgHvacStatus/Latest
  service interface HvacStatus
    namespaces:
      symbol props ns0: symbol=nsprototype
      symbol props ns1: symbol=nsserviceinterface
      symbol props ns2: symbol=nshvacstatus
    events:
      4 x data, all with type=uint32_t:
        CompressorStatus
        ValveStatus
        FanRightSpeed
        FanLeftSpeed
    methods:
      operation SetDegree: fire-and-forget=false
        arg Value: type=uint8_t, direction=IN
package /ServiceInterfaces/PkgHvacStatus/Latest/PkgDeployment
  user defined service interface deployment IpcSvcIfDeploy_HvacStatus: service-interface=HvacStatus
    4 x user defined event deployment:
      IpcEventDeploy_CompressorStatus: event=CompressorStatus
      IpcEventDeploy_ValveStatus: event=ValveStatus
      IpcEventDeploy_FanRightSpeed: event=FanRightSpeed
      IpcEventDeploy_FanLeftSpeed: event=FanLeftSpeed
    user defined method deployment IpcMethodDeploy_SetDegree: method=SetDegree
